## arch/arm/mach-synaptics/drivers/otp/Kconfig
```kconfig
config SYNA_KLAMATH_OTP
	bool "Support Synaptics OTP in U-BOOT"
	depends on SYNA_SUBOOT && TARGET_KLAMATH
	default y
```

## arch/arm/mach-synaptics/drivers/regulator/Kconfig
```kconfig
config REGULATOR_RASPBERRYPI_TOUCHSCREEN_ATTINY
	bool "Enable regulator on waveshare raspberry pi touchscreen"
	depends on VIDEO_SYNA
	help
	  Select this option if you are using a Waveshare Raspberry Pi
	  touchscreen display that includes ATtiny-based power control and
	  want the kernel to manage its voltage regulators.

config REGULATOR_WAVESHARE_TOUCHSCREEN
	bool "Enable Waveshare touchscreen panel regulator"
	depends on VIDEO_SYNA
	help
	  This driver supports regulator on the waveshare
	  touchscreen unit. The regulator is used to enable power to the
	  display and to control backlight.
```

## arch/arm/mach-synaptics/drivers/video/Kconfig
```kconfig
config VIDEO_SYNA
	bool "Enable Syna Display support"
	depends on ARCH_SYNAPTICS
	depends on VIDEO
	help
	  This enables support for Synaptics display for
	  Edge Soc family

config PANEL_CFG
	string "Panel Config file"
	depends on VIDEO_SYNA
	help
		Configures the panel information from Header file provided.

config SYNA_DRM_BRIDGE_LT9611
	bool "Syna driver based LT9611 bridge"
	select VIDEO_BRIDGE
	depends on VIDEO_SYNA
	help
	  Enable this option to configures Syna driver based
	  LT9611 bridge support

config SYNA_WSPANEL_1080P
	bool "syna compatible wspanel 1080p resolution"
	depends on VIDEO_SYNA
	help
	  Enable this option to the syna compatible waveshare 13.3 inch panel with
	  1080p resolution

config DEFAULT_PANEL_DTBO
	string "Panel default dtbo file"
	depends on VIDEO_SYNA
	help
		Configures the default panel dtbo to be applied.

config PANEL_DTBO_PATH
	string "Rootfs path to dtbo file"
	depends on VIDEO_SYNA
	help
		Configures the rootfs path to find panel dtbo.

config SYNA_DISABLE_BOOTLOGO
	hex "Boot logo disable control (bit0=uboot, bit1=kernel)"
	default 0x0
	help
		Bit 0: Disable U-Boot logo (0=show, 1=disable)
		Bit 1: Disable Kernel logo (0=show, 1=disable)

		0x0 = Show both logos (default)
		0x1 = Disable U-Boot logo, show kernel logo
		0x2 = Show U-Boot logo, disable kernel logo
		0x3 = Disable both logos

config SYNA_DISABLE_FBCON
	bool "Disable FBCON in kernel"
	default n
	help
	  Disable FBCON in kernel. When enabled, the kernel will
	  not attach a text console to the fbdev, which prevent
	  console output from appearing on display during boot
	  and runtime. Enable if display pipeline is managed
	  exclusively by userspace(wayland/drm application).
	  Disable for head-less environment without serial console.
```
